#include "secrets.h"
#include <Wire.h>
#include <Adafruit_GFX.h>
#include <Adafruit_SSD1306.h>
#include <Adafruit_AHTX0.h>
#include <Adafruit_BMP280.h>
#include <BH1750.h>
#include <WiFi.h>
#include <time.h>
#include <sys/time.h>
#include <Firebase_ESP_Client.h>
#include <ESP32Servo.h>
#include <addons/TokenHelper.h>
#include <addons/RTDBHelper.h>

const char* ssid = WIFI_SSID;
const char* password = WIFI_PASSWORD;

// Robot ID phải trùng với quyền được cấp trên dashboard.
#define ROBOT_ID "desk_robot_01"

String fbPath(const char* subPath) {
  return String("/RobotDashboard/Robots/") + ROBOT_ID + subPath;
}

// Epoch millisecond dùng chung với Date.now() trên dashboard.
// Trả về 0 khi NTP chưa đồng bộ để bỏ qua phép đo độ trễ.
unsigned long long getEpochMs() {
  struct timeval tv;
  gettimeofday(&tv, nullptr);
  if (tv.tv_sec < 1700000000) {  // Chưa có thời gian NTP hợp lệ
    return 0ULL;
  }
  return (unsigned long long)tv.tv_sec * 1000ULL + (unsigned long long)(tv.tv_usec / 1000ULL);
}

String epochMsToString(unsigned long long value) {
  char buffer[32];
  snprintf(buffer, sizeof(buffer), "%llu", value);
  return String(buffer);
}

String nowEpochMsString() { return epochMsToString(getEpochMs()); }

FirebaseData fbdo;
FirebaseAuth auth;
FirebaseConfig config;

#define TOUCH_PIN 4
#define BUZZER_PIN 27  // Doi lai dung chan buzzer cua ban neu khac
#define LED_PIN 2      // LED onboard ESP32 thuong la GPIO2

#define SERVO_DAU_PIN 18
#define SERVO_TAY_TRAI_PIN 16
#define SERVO_TAY_PHAI_PIN 17

Servo servoDau;
Servo servoTayTrai;
Servo servoTayPhai;

// Góc servo: trái/lên 30°, giữa 90°, phải/xuống 150°.
const int GOC_GIUA = 90;
const int DAU_TRAI = 30;
const int DAU_PHAI = 150;

const int TAY_TRAI_LEN = 30;
const int TAY_TRAI_XUONG = 150;
const int TAY_PHAI_LEN = 150;
const int TAY_PHAI_XUONG = 30;

String lenh_robot_cu = "";
String command_request_id_cu = "";  // Dùng để tránh xử lý lặp CommandRequest cũ
unsigned long sensor_seq = 0;       // Số thứ tự gói dữ liệu cảm biến để Dashboard nhận biết mẫu mới
unsigned long thoi_gian_doc_lenh_robot = 0;

#define POMODORO_WORK_SECONDS 1500UL  // 25 phut
#define POMODORO_BREAK_SECONDS 300UL  // 5 phut nghi

Adafruit_SSD1306 display(128, 64, &Wire, -1);
Adafruit_AHTX0 aht;
Adafruit_BMP280 bmp;
BH1750 lightMeter;

int trang_thai_man_hinh = 0;
// Màn hình: 0 = mắt, 1 = thời tiết, 2 = đồng hồ.
bool can_ve_lai_ngay = true;
int trang_thai_nut_cu = LOW;
// Giữ D4 3 giây để bật/hủy học; chạm ngắn để đổi màn hình.
unsigned long thoi_diem_nhan = 0;
bool da_xu_ly_nhan_giu = false;

unsigned long thoi_gian_cap_nhat_cam_bien = 0;
unsigned long thoi_gian_cap_nhat_gio = 0;

int trang_thai_mat = 0;
unsigned long thoi_gian_truoc_mat = 0;

unsigned long mat_thoi_gian_cho = 0;
int mat_so_lan_chop_con_lai = 0;

#define DUNG_BITMAP_MAT_PHU 1

const unsigned char mat_liec_trai[] PROGMEM = {
    0x00, 0x00, 0x00, 0x00, 0x00, 0x00, 0x00, 0x00, 0x00, 0x00, 0x00, 0x00, 0x00, 0x00, 0x00, 0x01,
    0x00, 0x00, 0x00, 0x00, 0x00, 0x00, 0x00, 0x00, 0x00, 0x00, 0x00, 0x00, 0x00, 0x00, 0x00, 0x00,
    0x00, 0x00, 0x00, 0x00, 0x00, 0x00, 0x00, 0x00, 0x00, 0x00, 0x00, 0x00, 0x00, 0x00, 0x00, 0x00,
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    0x00, 0x00, 0x00, 0x00, 0x00, 0x00, 0x00, 0x03, 0xf0, 0x00, 0x00, 0x00, 0x00, 0x00, 0x00, 0x00};

const unsigned char mat_liec_phai[] PROGMEM = {
    0x80, 0x00, 0x00, 0x00, 0x00, 0x00, 0x00, 0x00, 0x00, 0x00, 0x00, 0x00, 0x00, 0x00, 0x00, 0x00,
    0x00, 0x00, 0x00, 0x00, 0x00, 0x00, 0x00, 0x00, 0x00, 0x00, 0x00, 0x00, 0x00, 0x00, 0x00, 0x00,
    0x00, 0x00, 0x00, 0x00, 0x00, 0x00, 0x00, 0x00, 0x00, 0x00, 0x00, 0x00, 0x00, 0x00, 0x00, 0x00,
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    0x00, 0x00, 0x00, 0x00, 0x00, 0x00, 0x00, 0x00, 0x00, 0x00, 0x00, 0x00, 0x00, 0x00, 0x00, 0x00};

const unsigned char mat_liec_len[] PROGMEM = {
    0xc0, 0x00, 0x00, 0x00, 0x00, 0x00, 0x00, 0x00, 0x00, 0x00, 0x00, 0x00, 0x00, 0x00, 0x00, 0x01,
    0x00, 0x00, 0x00, 0x1f, 0x80, 0x00, 0x00, 0x00, 0x00, 0x00, 0x00, 0x00, 0x00, 0x00, 0x00, 0x00,
    0x00, 0x00, 0x03, 0xff, 0xfe, 0x00, 0x00, 0x00, 0x00, 0x00, 0x00, 0x00, 0x00, 0x00, 0x00, 0x00,
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    0x00, 0x00, 0x00, 0x00, 0x00, 0x00, 0x00, 0x00, 0x00, 0x00, 0x00, 0x00, 0x00, 0x00, 0x00, 0x00};

enum TrangThaiRanh {
  RANH_CHO = 0,
  KB_A_LIEC_TRAI,
  KB_A_LIEC_PHAI,
  KB_B_CHOP_1,
  KB_B_MO_1,
  KB_B_CHOP_2,
  KB_B_MO_2,
  KB_C_LIEC_LEN
};

TrangThaiRanh trang_thai_ranh = RANH_CHO;

unsigned long moc_thoi_gian_ranh = 0;
unsigned long thoi_gian_cho_ranh = 0;
unsigned long moc_buoc_ranh = 0;
int kich_ban_ranh = 0;  // 1=A, 2=B, 3=C

enum TrangThaiVuiD4 { VUI_D4_RANH = 0, VUI_D4_VAY_DUOI, VUI_D4_THA_NHIN_LEN };

TrangThaiVuiD4 trang_thai_vui_d4 = VUI_D4_RANH;
unsigned long moc_vui_d4 = 0;
unsigned long moc_vay_duoi_vui_d4 = 0;
int goc_duoi_vui_d4 = 60;

void bat_dau_vui_d4();
void xu_ly_vui_d4();
void dat_lai_may_trang_thai_ranh();
void xu_ly_may_trang_thai_ranh();
bool duoc_chay_kich_ban_ranh();

unsigned long thoi_gian_day_firebase = 0;

bool pomodoro_dang_chay = false;
bool pomodoro_dang_nghi = false;
unsigned long pomodoro_bat_dau_ms = 0;
unsigned long pomodoro_tong_giay = POMODORO_WORK_SECONDS;
unsigned long thoi_gian_day_pomodoro = 0;
unsigned long thoi_gian_ve_pomodoro = 0;
int pomodoro_giay_con_lai_cu = -1;

const unsigned char mat_mo[] PROGMEM = {
    0x00, 0x00, 0x00, 0x00, 0x00, 0x00, 0x00, 0x00, 0x00, 0x00, 0x00, 0x00, 0x00, 0x00, 0x00, 0x00,
    0x00, 0x00, 0x00, 0x00, 0x00, 0x00, 0x00, 0x00, 0x00, 0x00, 0x00, 0x00, 0x00, 0x00, 0x00, 0x00,
    0x00, 0x00, 0x00, 0x00, 0x00, 0x00, 0x00, 0x00, 0x00, 0x00, 0x00, 0x00, 0x00, 0x00, 0x00, 0x00,
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    0x00, 0x00, 0x00, 0x00, 0x00, 0x00, 0x00, 0x00, 0x00, 0x00};

void servo_ve_giua() {
  servoDau.write(GOC_GIUA);
  servoTayTrai.write(GOC_GIUA);
  servoTayPhai.write(GOC_GIUA);
}

void nhin_trai() {
  Serial.println("Robot: NHIN_TRAI");
  ve_mat_liec_trai();
  servoDau.write(DAU_TRAI);
  delay(600);
}

void nhin_phai() {
  Serial.println("Robot: NHIN_PHAI");
  ve_mat_liec_phai();
  servoDau.write(DAU_PHAI);
  delay(600);
}

void nhin_thang() {
  Serial.println("Robot: NHIN_THANG");
  servo_ve_giua();
  can_ve_lai_ngay = true;
}

void lac_dau() {
  Serial.println("Robot: LAC_DAU");
  for (int i = 0; i < 3; i++) {
    ve_mat_liec_trai();
    servoDau.write(DAU_TRAI);
    delay(300);

    ve_mat_liec_phai();
    servoDau.write(DAU_PHAI);
    delay(300);
  }

  servoDau.write(GOC_GIUA);
  can_ve_lai_ngay = true;
}

void vay_tay_trai() {
  Serial.println("Robot: VAY_TAY_TRAI");
  for (int i = 0; i < 3; i++) {
    servoTayTrai.write(TAY_TRAI_LEN);
    delay(250);

    servoTayTrai.write(TAY_TRAI_XUONG);
    delay(250);
  }

  servoTayTrai.write(GOC_GIUA);
}

void vay_tay_phai() {
  Serial.println("Robot: VAY_TAY_PHAI");

  for (int i = 0; i < 3; i++) {
    servoTayPhai.write(TAY_PHAI_LEN);
    delay(250);

    servoTayPhai.write(TAY_PHAI_XUONG);
    delay(250);
  }

  servoTayPhai.write(GOC_GIUA);
}

void vay_hai_tay() {
  Serial.println("Robot: VAY_HAI_TAY");
  for (int i = 0; i < 4; i++) {
    servoTayTrai.write(TAY_TRAI_LEN);
    servoTayPhai.write(TAY_PHAI_LEN);
    delay(250);

    servoTayTrai.write(TAY_TRAI_XUONG);
    servoTayPhai.write(TAY_PHAI_XUONG);
    delay(250);
  }

  servoTayTrai.write(GOC_GIUA);
  servoTayPhai.write(GOC_GIUA);
}

void chao_robot() {
  Serial.println("Robot: CHAO");
  servo_ve_giua();
  delay(150);
  ve_mat_mo();
  servoDau.write(DAU_TRAI);
  delay(250);
  servoDau.write(DAU_PHAI);
  delay(250);
  servoDau.write(GOC_GIUA);
  delay(200);
  for (int i = 0; i < 3; i++) {
    servoTayTrai.write(TAY_TRAI_LEN);
    servoTayPhai.write(TAY_PHAI_LEN);
    digitalWrite(LED_PIN, HIGH);
    delay(250);

    servoTayTrai.write(TAY_TRAI_XUONG);
    servoTayPhai.write(TAY_PHAI_XUONG);
    digitalWrite(LED_PIN, LOW);
    delay(250);
  }

  servo_ve_giua();
  can_ve_lai_ngay = true;
}

void hien_thi_oled_text(String noi_dung) {
  display.clearDisplay();
  display.setTextColor(SSD1306_WHITE);
  display.setTextSize(1);
  display.setCursor(0, 0);
  display.println("THONG BAO:");
  display.drawLine(0, 11, 128, 11, SSD1306_WHITE);

  int y = 16;
  int start = 0;
  while (start < noi_dung.length() && y <= 56) {
    String dong = noi_dung.substring(start, min(start + 20, (int)noi_dung.length()));
    display.setCursor(0, y);
    display.println(dong);
    start += 20;
    y += 10;
  }
  display.display();
}

void xu_ly_lenh_robot(String lenh) {
  lenh.trim();
  if (lenh.length() == 0 || lenh == "NONE" || lenh == "null") return;
  if (lenh.startsWith("OLED:")) {
    String nd = lenh.substring(5);
    nd.trim();
    hien_thi_oled_text(nd);
    lenh_robot_cu = lenh;
    return;
  }

  if (lenh.startsWith("EMOTION:")) {
    String cx = lenh.substring(8);
    cx.trim();
    if (cx == "TRAI")
      ve_mat_liec_trai();
    else if (cx == "PHAI")
      ve_mat_liec_phai();
    else if (cx == "LEN")
      ve_mat_liec_len();
    else if (cx == "NHAM")
      ve_mat_nham();
    else
      ve_mat_mo();
    lenh_robot_cu = lenh;
    return;
  }

  if (lenh == "DUNG" || lenh == "NHIN_THANG") {
    nhin_thang();
  } else if (lenh == "CHAO") {
    chao_robot();
  } else if (lenh == "VAY_TAY_TRAI") {
    vay_tay_trai();
  } else if (lenh == "VAY_TAY_PHAI") {
    vay_tay_phai();
  } else if (lenh == "VAY_HAI_TAY") {
    vay_hai_tay();
  } else if (lenh == "LAC_DAU") {
    lac_dau();
  } else if (lenh == "NHIN_TRAI" || lenh == "QUAY_DAU_TRAI") {
    nhin_trai();
  } else if (lenh == "NHIN_PHAI" || lenh == "QUAY_DAU_PHAI") {
    nhin_phai();
  } else if (lenh == "POMODORO" || lenh == "BAT_DAU_HOC") {
    bat_dau_pomodoro_lam_viec();
  } else if (lenh == "DUNG_HOC") {
    ket_thuc_pomodoro();
  } else if (lenh == "MOI_TRUONG") {
    trang_thai_man_hinh = 1;
    can_ve_lai_ngay = true;
  } else {
    Serial.print("Lenh khong hop le: ");
    Serial.println(lenh);
  }

  dat_lai_may_trang_thai_ranh();
}

bool la_lenh_hop_le_can_xu_ly(String lenh) {
  lenh.trim();
  return lenh.length() > 0 && lenh != "NONE" && lenh != "null";
}

void ghi_command_ack(String requestId, String lenh, String status, unsigned long long espReceivedAt,
                     unsigned long long espExecutedAt) {
  if (!Firebase.ready() || requestId.length() == 0) return;

  Firebase.RTDB.setString(&fbdo, fbPath("/ThietBi/CommandAck/requestId"), requestId);
  Firebase.RTDB.setString(&fbdo, fbPath("/ThietBi/CommandAck/command"), lenh);
  Firebase.RTDB.setString(&fbdo, fbPath("/ThietBi/CommandAck/status"), status);
  Firebase.RTDB.setString(&fbdo, fbPath("/ThietBi/CommandAck/espReceivedAt"),
                          epochMsToString(espReceivedAt));
  Firebase.RTDB.setString(&fbdo, fbPath("/ThietBi/CommandAck/espExecutedAt"),
                          epochMsToString(espExecutedAt));
  Firebase.RTDB.setString(&fbdo, fbPath("/ThietBi/CommandAck/robotId"), ROBOT_ID);
  Firebase.RTDB.setString(&fbdo, fbPath("/ThietBi/CommandAck/updatedAt"), nowEpochMsString());
}

void doc_lenh_robot_tu_firebase() {
  if (!Firebase.ready()) return;
  if (millis() - thoi_gian_doc_lenh_robot < 300) return;
  thoi_gian_doc_lenh_robot = millis();

  String lenh = "";
  String requestId = "";
  bool co_command_request_moi = false;

  // CommandRequest chứa requestId và webSentAt để đo độ trễ.
  if (Firebase.RTDB.getString(&fbdo, fbPath("/ThietBi/CommandRequest/requestId"))) {
    requestId = fbdo.stringData();
    requestId.trim();

    if (requestId.length() > 0 && requestId != command_request_id_cu) {
      if (Firebase.RTDB.getString(&fbdo, fbPath("/ThietBi/CommandRequest/command"))) {
        lenh = fbdo.stringData();
        lenh.trim();
        if (la_lenh_hop_le_can_xu_ly(lenh)) {
          co_command_request_moi = true;
        }
      }
    }
  }

  // Đọc LenhDieuKhien để tương thích với dashboard cũ.
  if (!co_command_request_moi) {
    if (Firebase.RTDB.getString(&fbdo, fbPath("/ThietBi/LenhDieuKhien"))) {
      lenh = fbdo.stringData();
      lenh.trim();
    }
  }

  if (!la_lenh_hop_le_can_xu_ly(lenh)) return;

  unsigned long long espReceivedAt = getEpochMs();

  Serial.print("Lenh robot Firebase: ");
  Serial.println(lenh);
  if (co_command_request_moi) {
    Serial.print("CommandRequest ID: ");
    Serial.println(requestId);
  }

  if (Firebase.ready()) {
    Firebase.RTDB.setString(&fbdo, fbPath("/ThietBi/CheDo"), "DANG_CHAY");
    Firebase.RTDB.setString(&fbdo, fbPath("/ThietBi/LenhDangChay"), lenh);
    Firebase.RTDB.setString(&fbdo, fbPath("/ThietBi/ThoiGianNhanLenh"),
                            epochMsToString(espReceivedAt));

    if (co_command_request_moi) {
      Firebase.RTDB.setString(&fbdo, fbPath("/ThietBi/CommandRequest/status"), "RECEIVED_BY_ESP32");
      Firebase.RTDB.setString(&fbdo, fbPath("/ThietBi/CommandRequest/espReceivedAt"),
                              epochMsToString(espReceivedAt));
    }
  }

  dat_lai_may_trang_thai_ranh();
  xu_ly_lenh_robot(lenh);

  unsigned long long espExecutedAt = getEpochMs();

  lenh_robot_cu = lenh;
  if (co_command_request_moi) {
    command_request_id_cu = requestId;
    ghi_command_ack(requestId, lenh, "DONE", espReceivedAt, espExecutedAt);
  }

  if (Firebase.ready()) {
    Firebase.RTDB.setString(&fbdo, fbPath("/ThietBi/LenhCuoi"), lenh);
    Firebase.RTDB.setString(&fbdo, fbPath("/ThietBi/LenhDangChay"), "NONE");
    Firebase.RTDB.setString(&fbdo, fbPath("/ThietBi/CheDo"), "IDLE");
    Firebase.RTDB.setString(&fbdo, fbPath("/ThietBi/LenhDieuKhien"), "NONE");
    Firebase.RTDB.setString(&fbdo, fbPath("/ThietBi/ThoiGianCapNhat"), nowEpochMsString());
  }
}

void setup() {
  Serial.begin(115200);
  delay(1000);
  randomSeed((uint32_t)(micros() ^ analogRead(34)));

  Serial.println();
  Serial.println("BAT DAU KHOI DONG ESP32");
  pinMode(TOUCH_PIN, INPUT_PULLDOWN);
  pinMode(BUZZER_PIN, OUTPUT);
  pinMode(LED_PIN, OUTPUT);
  digitalWrite(BUZZER_PIN, LOW);
  digitalWrite(LED_PIN, LOW);

  // Khởi tạo I2C và OLED trước khi vẽ hoặc chạy servo.
  Wire.begin(21, 22);
  if (!display.begin(SSD1306_SWITCHCAPVCC, 0x3C)) {
    Serial.println("Loi OLED 0x3C. Thu dia chi 0x3D neu can.");
    while (true) {
      delay(1000);
    }
  }

  display.clearDisplay();
  display.setTextSize(1);
  display.setTextColor(SSD1306_WHITE);
  display.setCursor(0, 20);
  display.println("Khoi dong ESP32...");
  display.display();
  Serial.println("OLED OK");

  if (!aht.begin()) {
    Serial.println("Loi AHT20!");
  } else {
    Serial.println("AHT20 OK");
  }

  if (bmp.begin(0x76)) {
    Serial.println("BMP280 OK 0x76");
  } else if (bmp.begin(0x77)) {
    Serial.println("BMP280 OK 0x77");
  } else {
    Serial.println("Loi BMP280!");
  }

  if (!lightMeter.begin()) {
    Serial.println("Loi BH1750!");
  } else {
    Serial.println("BH1750 OK");
  }

  // Khởi tạo servo sau OLED để tránh StoreProhibited.
  servoDau.setPeriodHertz(50);
  servoTayTrai.setPeriodHertz(50);
  servoTayPhai.setPeriodHertz(50);

  servoDau.attach(SERVO_DAU_PIN, 500, 2500);
  servoTayTrai.attach(SERVO_TAY_TRAI_PIN, 500, 2500);
  servoTayPhai.attach(SERVO_TAY_PHAI_PIN, 500, 2500);

  servo_ve_giua();
  Serial.println("Servo OK");

  display.clearDisplay();
  display.setTextSize(1);
  display.setTextColor(SSD1306_WHITE);
  display.setCursor(10, 30);
  display.print("Dang noi WiFi...");
  display.display();

  WiFi.begin(ssid, password);
  Serial.print("Dang ket noi WiFi");
  while (WiFi.status() != WL_CONNECTED) {
    delay(500);
    Serial.print(".");
  }
  Serial.println("\nWiFi OK!");
  Serial.println("================================");
  Serial.print("DIA CHI IP ESP32: ");
  Serial.println(WiFi.localIP());
  Serial.println("================================");

  display.clearDisplay();
  display.setTextSize(1);
  display.setTextColor(SSD1306_WHITE);
  display.setCursor(0, 0);
  display.println("WiFi OK");
  display.println("IP ESP32:");
  display.println(WiFi.localIP());
  display.display();
  delay(2000);

  // Độ trễ dùng epoch UTC; OLED hiển thị giờ Việt Nam.
  configTime(0, 0, "pool.ntp.org", "time.nist.gov");
  setenv("TZ", "ICT-7", 1);
  tzset();
  struct tm timeInfo;
  if (getLocalTime(&timeInfo, 10000)) {
    Serial.println("Da dong bo NTP UTC + hien thi gio Viet Nam!");
  } else {
    Serial.println("Canh bao: chua dong bo duoc NTP, lan do do tre dau tien co the bi bo qua.");
  }

  config.api_key = API_KEY;
  config.database_url = DATABASE_URL;
  config.token_status_callback = tokenStatusCallback;
  if (Firebase.signUp(&config, &auth, "", "")) {
    Serial.println("Firebase signUp OK!");
  } else {
    Serial.print("Firebase signUp loi: ");
    Serial.println(config.signer.signupError.message.c_str());
  }

  Firebase.begin(&config, &auth);
  Firebase.reconnectWiFi(true);
  Serial.println("Firebase dang khoi tao...");
  if (Firebase.ready()) {
    Firebase.RTDB.setString(&fbdo, fbPath("/ThietBi/TenThietBi"), "DeskRobot_ESP32");
    Firebase.RTDB.setString(&fbdo, fbPath("/ThietBi/RobotId"), ROBOT_ID);
    Firebase.RTDB.setString(&fbdo, fbPath("/ThietBi/TrangThai"), "ONLINE");
    Firebase.RTDB.setString(&fbdo, fbPath("/ThietBi/CheDo"), "IDLE");
    Firebase.RTDB.setString(&fbdo, fbPath("/ThietBi/IP"), WiFi.localIP().toString());
    Firebase.RTDB.setString(&fbdo, fbPath("/Dashboard/CheDoDieuKhien"), "FIREBASE");
    Firebase.RTDB.setString(&fbdo, fbPath("/ThietBi/LenhDangChay"), "NONE");
    Firebase.RTDB.setString(&fbdo, fbPath("/ThietBi/LenhCuoi"), "NONE");
    Firebase.RTDB.setString(&fbdo, fbPath("/ThietBi/LenhDieuKhien"), "NONE");

    // Đọc requestId hiện tại để tránh lặp lệnh sau khi reset.
    Firebase.RTDB.setString(&fbdo, fbPath("/ThietBi/CommandAck/status"), "READY");
    if (Firebase.RTDB.getString(&fbdo, fbPath("/ThietBi/CommandRequest/requestId"))) {
      command_request_id_cu = fbdo.stringData();
      command_request_id_cu.trim();
    }

    Firebase.RTDB.setString(&fbdo, fbPath("/RobotInfo/robotId"), ROBOT_ID);
    Firebase.RTDB.setString(&fbdo, fbPath("/RobotInfo/name"), "DeskRobot_ESP32");
    Firebase.RTDB.setString(&fbdo, fbPath("/RobotInfo/status"), "ONLINE");
    Firebase.RTDB.setString(&fbdo, fbPath("/RobotInfo/ip"), WiFi.localIP().toString());
    Firebase.RTDB.setInt(&fbdo, fbPath("/RobotInfo/lastSeen"), (int)time(nullptr));
  }

  can_ve_lai_ngay = true;
  dat_lai_may_trang_thai_ranh();

  chao_robot();

  Serial.println("HE THONG SAN SANG");
}

void ve_mat_mo() {
  display.clearDisplay();
  display.drawBitmap(0, 0, mat_mo, 128, 64, SSD1306_WHITE);
  display.display();
}

void ve_mat_nham() {
  display.clearDisplay();
  display.fillRoundRect(22, 31, 34, 5, 2, SSD1306_WHITE);
  display.fillRoundRect(72, 31, 34, 5, 2, SSD1306_WHITE);
  display.display();
}

void ve_bitmap_neu_co(const unsigned char* bitmap) {
  display.clearDisplay();
  display.drawBitmap(0, 0, bitmap, 128, 64, SSD1306_WHITE);
  display.display();
}

void ve_mat_liec_trai() {
#if DUNG_BITMAP_MAT_PHU
  ve_bitmap_neu_co(mat_liec_trai);
#else
  display.clearDisplay();
  display.drawRoundRect(18, 18, 38, 26, 8, SSD1306_WHITE);
  display.drawRoundRect(72, 18, 38, 26, 8, SSD1306_WHITE);
  display.fillCircle(28, 31, 5, SSD1306_WHITE);
  display.fillCircle(82, 31, 5, SSD1306_WHITE);
  display.display();
#endif
}

void ve_mat_liec_phai() {
#if DUNG_BITMAP_MAT_PHU
  ve_bitmap_neu_co(mat_liec_phai);
#else
  display.clearDisplay();
  display.drawRoundRect(18, 18, 38, 26, 8, SSD1306_WHITE);
  display.drawRoundRect(72, 18, 38, 26, 8, SSD1306_WHITE);
  display.fillCircle(46, 31, 5, SSD1306_WHITE);
  display.fillCircle(100, 31, 5, SSD1306_WHITE);
  display.display();
#endif
}

void ve_mat_liec_len() {
#if DUNG_BITMAP_MAT_PHU
  ve_bitmap_neu_co(mat_liec_len);
#else
  display.clearDisplay();
  display.drawRoundRect(18, 18, 38, 26, 8, SSD1306_WHITE);
  display.drawRoundRect(72, 18, 38, 26, 8, SSD1306_WHITE);
  display.fillCircle(37, 24, 5, SSD1306_WHITE);
  display.fillCircle(91, 24, 5, SSD1306_WHITE);
  display.drawLine(54, 54, 74, 54, SSD1306_WHITE);
  display.display();
#endif
}

bool duoc_chay_kich_ban_ranh() {
  if (trang_thai_man_hinh != 0) return false;
  if (pomodoro_dang_chay) return false;
  if (trang_thai_vui_d4 != VUI_D4_RANH) return false;
  return true;
}

void dat_lai_may_trang_thai_ranh() {
  trang_thai_ranh = RANH_CHO;
  kich_ban_ranh = 0;
  moc_thoi_gian_ranh = millis();
  thoi_gian_cho_ranh = random(5000, 10001);  // 5 den 10 giay
  moc_buoc_ranh = millis();
  // Giữ vị trí servo khi đang chạy hiệu ứng vui D4.
  if (trang_thai_vui_d4 == VUI_D4_RANH) {
    servo_ve_giua();
  }
}

void bat_dau_kich_ban_ranh() {
  kich_ban_ranh = random(1, 4);
  // Kịch bản: 1 = tò mò, 2 = vui, 3 = buồn chán.
  moc_buoc_ranh = millis();

  Serial.print("Bat dau kich ban ranh: ");
  Serial.println(kich_ban_ranh);
  if (kich_ban_ranh == 1) {
    trang_thai_ranh = KB_A_LIEC_TRAI;
    ve_mat_liec_trai();
    servoTayPhai.write(65);
    servoTayTrai.write(90);
  } else if (kich_ban_ranh == 2) {
    trang_thai_ranh = KB_B_CHOP_1;
    ve_mat_nham();
    servoTayTrai.write(70);
  } else {
    trang_thai_ranh = KB_C_LIEC_LEN;
    ve_mat_liec_len();
    servo_ve_giua();
  }
}

// Chuyển trạng thái bằng millis() để tránh chặn vòng lặp.
void xu_ly_may_trang_thai_ranh() {
  if (!duoc_chay_kich_ban_ranh()) {
    dat_lai_may_trang_thai_ranh();
    return;
  }

  unsigned long now = millis();

  switch (trang_thai_ranh) {
    case RANH_CHO:
      if (moc_thoi_gian_ranh == 0) dat_lai_may_trang_thai_ranh();
      if (now - moc_thoi_gian_ranh >= thoi_gian_cho_ranh) {
        bat_dau_kich_ban_ranh();
      }
      break;

    case KB_A_LIEC_TRAI:
      if (now - moc_buoc_ranh >= 1000) {
        trang_thai_ranh = KB_A_LIEC_PHAI;
        moc_buoc_ranh = now;
        ve_mat_liec_phai();
        servoTayPhai.write(115);
        servoTayTrai.write(90);
      }
      break;
    case KB_A_LIEC_PHAI:
      if (now - moc_buoc_ranh >= 1000) {
        can_ve_lai_ngay = true;
        dat_lai_may_trang_thai_ranh();
      }
      break;

    case KB_B_CHOP_1:
      if (now - moc_buoc_ranh >= 130) {
        trang_thai_ranh = KB_B_MO_1;
        moc_buoc_ranh = now;
        ve_mat_mo();
        servoTayTrai.write(110);
      }
      break;
    case KB_B_MO_1:
      if (now - moc_buoc_ranh >= 130) {
        trang_thai_ranh = KB_B_CHOP_2;
        moc_buoc_ranh = now;
        ve_mat_nham();
      }
      break;
    case KB_B_CHOP_2:
      if (now - moc_buoc_ranh >= 130) {
        trang_thai_ranh = KB_B_MO_2;
        moc_buoc_ranh = now;
        ve_mat_mo();
        servoTayTrai.write(90);
      }
      break;
    case KB_B_MO_2:
      if (now - moc_buoc_ranh >= 350) {
        can_ve_lai_ngay = true;
        dat_lai_may_trang_thai_ranh();
      }
      break;

    case KB_C_LIEC_LEN:
      if (now - moc_buoc_ranh >= 2000) {
        can_ve_lai_ngay = true;
        dat_lai_may_trang_thai_ranh();
      }
      break;
  }
}

void bat_dau_vui_d4() {
  trang_thai_vui_d4 = VUI_D4_VAY_DUOI;
  moc_vui_d4 = millis();
  moc_vay_duoi_vui_d4 = millis();
  goc_duoi_vui_d4 = 70;

  // Tạm dừng kịch bản ngẫu nhiên khi hiệu ứng D4 đang chạy.
  trang_thai_ranh = RANH_CHO;
  ve_mat_liec_len();
  servoTayPhai.write(90);
  servoTayTrai.write(goc_duoi_vui_d4);

  Serial.println("D4: VUI VE");
}

void xu_ly_vui_d4() {
  unsigned long now = millis();
  // Chỉ chuyển động servo khi D4 còn được giữ.
  if (trang_thai_vui_d4 == VUI_D4_VAY_DUOI) {
    if (digitalRead(TOUCH_PIN) == LOW) {
      trang_thai_vui_d4 = VUI_D4_THA_NHIN_LEN;
      moc_vui_d4 = now;
      ve_mat_liec_len();
      servoTayTrai.write(90);  // dung vay, dua duoi ve giua
      servoTayPhai.write(90);
      return;
    }

    if (now - moc_vay_duoi_vui_d4 >= 180) {
      moc_vay_duoi_vui_d4 = now;
      if (goc_duoi_vui_d4 == 60) {
        goc_duoi_vui_d4 = 120;
      } else {
        goc_duoi_vui_d4 = 60;
      }

      servoTayTrai.write(goc_duoi_vui_d4);
      Serial.print("Vay duoi D4: ");
      Serial.println(goc_duoi_vui_d4);
    }
  }
  // Thả D4: dừng servo, nhìn lên 3 giây rồi về trạng thái mặc định.
  else if (trang_thai_vui_d4 == VUI_D4_THA_NHIN_LEN) {
    if (now - moc_vui_d4 >= 3000) {
      trang_thai_vui_d4 = VUI_D4_RANH;
      servo_ve_giua();
      can_ve_lai_ngay = true;
      dat_lai_may_trang_thai_ranh();
    }
  }
}

void hen_lan_chop_tiep_theo() {
  int kieu = random(0, 100);
  if (kieu < 12) {
    mat_thoi_gian_cho = random(450, 1200);
  } else if (kieu < 75) {
    mat_thoi_gian_cho = random(1800, 5200);
  } else {
    mat_thoi_gian_cho = random(6000, 9500);
  }

  thoi_gian_truoc_mat = millis();
  trang_thai_mat = 0;
}

void bat_dau_chop_mat() {
  int kieu = random(0, 100);
  if (kieu < 68) {
    mat_so_lan_chop_con_lai = 1;
  } else if (kieu < 90) {
    mat_so_lan_chop_con_lai = 2;
  } else {
    mat_so_lan_chop_con_lai = 3;
  }

  ve_mat_nham();
  if (random(0, 100) < 12) {
    mat_thoi_gian_cho = random(350, 850);
  } else {
    mat_thoi_gian_cho = random(85, 180);
  }

  thoi_gian_truoc_mat = millis();
  trang_thai_mat = 1;
}

void hieu_ung_nhay_mat() {
  unsigned long t_hien_tai = millis();

  if (can_ve_lai_ngay) {
    ve_mat_mo();
    can_ve_lai_ngay = false;
    mat_so_lan_chop_con_lai = 0;
    hen_lan_chop_tiep_theo();
    return;
  }

  switch (trang_thai_mat) {
    case 0:  // Mat dang mo, cho den lan chop tiep theo
      if (t_hien_tai - thoi_gian_truoc_mat >= mat_thoi_gian_cho) {
        bat_dau_chop_mat();
      }
      break;

    case 1:  // Mat dang nham
      if (t_hien_tai - thoi_gian_truoc_mat >= mat_thoi_gian_cho) {
        ve_mat_mo();
        mat_so_lan_chop_con_lai--;

        if (mat_so_lan_chop_con_lai > 0) {
          mat_thoi_gian_cho = random(70, 220);
          thoi_gian_truoc_mat = t_hien_tai;
          trang_thai_mat = 2;
        } else {
          hen_lan_chop_tiep_theo();
        }
      }
      break;
    case 2:  // Khoang mo ngan giua cac lan chop lien tuc
      if (t_hien_tai - thoi_gian_truoc_mat >= mat_thoi_gian_cho) {
        ve_mat_nham();
        mat_thoi_gian_cho = random(80, 170);
        thoi_gian_truoc_mat = t_hien_tai;
        trang_thai_mat = 1;
      }
      break;
  }
}

void hien_thi_thoi_tiet() {
  if (millis() - thoi_gian_cap_nhat_cam_bien > 1000 || can_ve_lai_ngay) {
    thoi_gian_cap_nhat_cam_bien = millis();
    can_ve_lai_ngay = false;

    sensors_event_t humidity, temp;
    aht.getEvent(&humidity, &temp);

    float nhietDo = temp.temperature;
    float doAm = humidity.relative_humidity;
    float anhSang = lightMeter.readLightLevel();
    struct tm thoi_gian;
    bool co_gio = getLocalTime(&thoi_gian);

    display.clearDisplay();
    display.setTextColor(SSD1306_WHITE);

    display.setTextSize(1);
    display.setCursor(0, 0);
    if (co_gio) {
      display.print(&thoi_gian, "%d/%m/%Y");
      display.setCursor(78, 0);
      display.print(&thoi_gian, "%H:%M");
    } else {
      display.print("Dang lay gio NTP");
    }

    display.drawLine(0, 10, 127, 10, SSD1306_WHITE);
    display.setCursor(20, 14);
    display.print("MOI TRUONG");

    display.setCursor(0, 28);
    display.print("Nhiet do: ");
    if (isfinite(nhietDo)) {
      display.print(nhietDo, 1);
      display.print(" C");
    } else {
      display.print("--.- C");
    }

    display.setCursor(0, 40);
    display.print("Do am   : ");
    if (isfinite(doAm)) {
      display.print(doAm, 0);
      display.print(" %");
    } else {
      display.print("-- %");
    }

    display.setCursor(0, 52);
    display.print("Lux:");
    if (isfinite(anhSang)) {
      display.print(anhSang, 0);
    } else {
      display.print("--");
    }
    display.setCursor(78, 52);
    display.print(Firebase.ready() ? "FB:OK" : "FB:...");

    display.display();
  }
}

void hien_thi_dong_ho() {
  if (millis() - thoi_gian_cap_nhat_gio > 1000 || can_ve_lai_ngay) {
    thoi_gian_cap_nhat_gio = millis();
    can_ve_lai_ngay = false;

    struct tm thoi_gian;
    if (!getLocalTime(&thoi_gian)) {
      display.clearDisplay();
      display.setCursor(15, 30);
      display.print("Dang lay gio...");
      display.display();
      return;
    }

    display.clearDisplay();
    display.setTextColor(SSD1306_WHITE);
    display.setTextSize(3);
    display.setCursor(20, 15);
    display.print(&thoi_gian, "%H:%M");
    display.setTextSize(1);
    display.setCursor(30, 50);
    display.print(&thoi_gian, "%d/%m/%Y");

    display.display();
  }
}

unsigned long pomodoro_giay_con_lai() {
  if (!pomodoro_dang_chay) return 0;
  unsigned long da_chay = (millis() - pomodoro_bat_dau_ms) / 1000UL;
  if (da_chay >= pomodoro_tong_giay) return 0;
  return pomodoro_tong_giay - da_chay;
}

void gui_trang_thai_pomodoro_firebase(const char* trang_thai, unsigned long con_lai, bool dang_chay,
                                      bool dang_nghi) {
  if (!Firebase.ready()) return;

  Firebase.RTDB.setString(&fbdo, fbPath("/Pomodoro/trangThai"), trang_thai);
  Firebase.RTDB.setBool(&fbdo, fbPath("/Pomodoro/dangChay"), dang_chay);
  Firebase.RTDB.setBool(&fbdo, fbPath("/Pomodoro/dangNghi"), dang_nghi);
  Firebase.RTDB.setInt(&fbdo, fbPath("/Pomodoro/conLaiGiay"), con_lai);
  Firebase.RTDB.setInt(&fbdo, fbPath("/Pomodoro/tongGiay"), pomodoro_tong_giay);

  int phan_tram = 0;
  if (pomodoro_tong_giay > 0) {
    phan_tram = (int)((pomodoro_tong_giay - con_lai) * 100UL / pomodoro_tong_giay);
  }
  Firebase.RTDB.setInt(&fbdo, fbPath("/Pomodoro/phanTram"), phan_tram);
  Firebase.RTDB.setInt(&fbdo, fbPath("/Pomodoro/updatedAt"), (int)time(nullptr));
}

void canh_bao_het_gio() {
  for (int i = 0; i < 5; i++) {
    digitalWrite(LED_PIN, HIGH);
    digitalWrite(BUZZER_PIN, HIGH);
    delay(180);
    digitalWrite(LED_PIN, LOW);
    digitalWrite(BUZZER_PIN, LOW);
    delay(180);
  }
}

void bat_dau_pomodoro_lam_viec() {
  pomodoro_dang_chay = true;
  pomodoro_dang_nghi = false;
  pomodoro_tong_giay = POMODORO_WORK_SECONDS;
  pomodoro_bat_dau_ms = millis();
  pomodoro_giay_con_lai_cu = -1;
  trang_thai_man_hinh = 3;
  can_ve_lai_ngay = true;

  gui_trang_thai_pomodoro_firebase("WORK", POMODORO_WORK_SECONDS, true, false);
  Serial.println("Pomodoro bat dau: 25 phut hoc tap");
}

void bat_dau_pomodoro_nghi() {
  pomodoro_dang_chay = true;
  pomodoro_dang_nghi = true;
  pomodoro_tong_giay = POMODORO_BREAK_SECONDS;
  pomodoro_bat_dau_ms = millis();
  pomodoro_giay_con_lai_cu = -1;
  trang_thai_man_hinh = 3;
  can_ve_lai_ngay = true;

  gui_trang_thai_pomodoro_firebase("BREAK", POMODORO_BREAK_SECONDS, true, true);
  Serial.println("Pomodoro nghi: 5 phut");
}

void ket_thuc_pomodoro() {
  pomodoro_dang_chay = false;
  pomodoro_dang_nghi = false;
  pomodoro_giay_con_lai_cu = -1;
  can_ve_lai_ngay = true;

  gui_trang_thai_pomodoro_firebase("DONE", 0, false, false);
  Serial.println("Pomodoro hoan tat!");
  canh_bao_het_gio();
}

void hien_thi_pomodoro() {
  if (millis() - thoi_gian_ve_pomodoro < 500 && !can_ve_lai_ngay) return;
  thoi_gian_ve_pomodoro = millis();
  can_ve_lai_ngay = false;

  unsigned long con_lai = pomodoro_giay_con_lai();
  int phut = con_lai / 60;
  int giay = con_lai % 60;
  display.clearDisplay();
  display.setTextColor(SSD1306_WHITE);

  display.setTextSize(1);
  display.setCursor(0, 0);
  if (pomodoro_dang_chay) {
    display.print(pomodoro_dang_nghi ? "NGHI 5 PHUT" : "POMODORO 25 PHUT");
  } else {
    display.print("POMODORO SAN SANG");
  }

  display.drawLine(0, 10, 127, 10, SSD1306_WHITE);

  display.setTextSize(3);
  display.setCursor(18, 20);
  if (phut < 10) display.print("0");
  display.print(phut);
  display.print(":");
  if (giay < 10) display.print("0");
  display.print(giay);

  display.setTextSize(1);
  display.setCursor(0, 55);
  display.print(Firebase.ready() ? "Firebase: OK" : "Firebase: ...");
  display.setCursor(86, 55);
  display.print(pomodoro_dang_chay ? "RUN" : "STOP");

  display.display();
}

void xu_ly_pomodoro() {
  if (!pomodoro_dang_chay) return;

  unsigned long con_lai = pomodoro_giay_con_lai();
  if ((int)con_lai != pomodoro_giay_con_lai_cu || millis() - thoi_gian_day_pomodoro > 1000) {
    pomodoro_giay_con_lai_cu = con_lai;
    thoi_gian_day_pomodoro = millis();
    gui_trang_thai_pomodoro_firebase(pomodoro_dang_nghi ? "BREAK" : "WORK", con_lai, true,
                                     pomodoro_dang_nghi);
  }

  if (con_lai == 0) {
    if (!pomodoro_dang_nghi) {
      gui_trang_thai_pomodoro_firebase("WORK_DONE", 0, false, false);
      canh_bao_het_gio();
      bat_dau_pomodoro_nghi();
    } else {
      ket_thuc_pomodoro();
    }
  }
}

void loop() {
  int doc_nut = digitalRead(TOUCH_PIN);
  if (doc_nut == HIGH && trang_thai_nut_cu == LOW) {
    thoi_diem_nhan = millis();
    da_xu_ly_nhan_giu = false;
    dat_lai_may_trang_thai_ranh();
  } else if (doc_nut == HIGH && trang_thai_nut_cu == HIGH) {
    if (millis() - thoi_diem_nhan >= 3000 && !da_xu_ly_nhan_giu) {
      da_xu_ly_nhan_giu = true;
      dat_lai_may_trang_thai_ranh();

      if (trang_thai_man_hinh == 0 && !pomodoro_dang_chay) {
        bat_dau_vui_d4();
      } else if (trang_thai_man_hinh == 3) {
        if (!pomodoro_dang_chay) {
          bat_dau_pomodoro_lam_viec();
        } else {
          ket_thuc_pomodoro();
        }
      }
    }
  } else if (doc_nut == LOW && trang_thai_nut_cu == HIGH) {
    if (trang_thai_vui_d4 == VUI_D4_VAY_DUOI) {
      trang_thai_vui_d4 = VUI_D4_THA_NHIN_LEN;
      moc_vui_d4 = millis();

      ve_mat_liec_len();
      servoTayTrai.write(90);
      servoTayPhai.write(90);
    } else if (!da_xu_ly_nhan_giu && (millis() - thoi_diem_nhan > 50)) {
      trang_thai_man_hinh++;
      if (trang_thai_man_hinh > 3) trang_thai_man_hinh = 0;

      can_ve_lai_ngay = true;
      dat_lai_may_trang_thai_ranh();

      Serial.print("--> Chuyen sang man hinh so: ");
      Serial.println(trang_thai_man_hinh);
    }
  }

  trang_thai_nut_cu = doc_nut;

  if (trang_thai_man_hinh == 0) {
    if (trang_thai_ranh == RANH_CHO && trang_thai_vui_d4 == VUI_D4_RANH) {
      hieu_ung_nhay_mat();
    }
  } else if (trang_thai_man_hinh == 1)
    hien_thi_thoi_tiet();
  else if (trang_thai_man_hinh == 2)
    hien_thi_dong_ho();
  else if (trang_thai_man_hinh == 3)
    hien_thi_pomodoro();

  xu_ly_vui_d4();

  xu_ly_may_trang_thai_ranh();

  xu_ly_pomodoro();

  doc_lenh_robot_tu_firebase();

  if (millis() - thoi_gian_day_firebase > 10000) {
    thoi_gian_day_firebase = millis();
    sensors_event_t humidity, temp;
    aht.getEvent(&humidity, &temp);

    if (Firebase.ready()) {
      bool ok = true;
      float nhietDo = temp.temperature;
      float doAm = humidity.relative_humidity;
      float anhSang = lightMeter.readLightLevel();
      unsigned long long espSentAt = getEpochMs();
      sensor_seq++;

      if (isfinite(nhietDo)) {
        if (!Firebase.RTDB.setFloat(&fbdo, fbPath("/ThongSo/NhietDo"), nhietDo)) {
          ok = false;
          Serial.print("Loi NhietDo: ");
          Serial.println(fbdo.errorReason());
        }
      } else {
        ok = false;
        Serial.println("Bo qua NhietDo: gia tri khong hop le");
      }

      if (isfinite(doAm)) {
        if (!Firebase.RTDB.setFloat(&fbdo, fbPath("/ThongSo/DoAm"), doAm)) {
          ok = false;
          Serial.print("Loi DoAm: ");
          Serial.println(fbdo.errorReason());
        }
      } else {
        ok = false;
        Serial.println("Bo qua DoAm: gia tri khong hop le");
      }

      if (isfinite(anhSang)) {
        if (!Firebase.RTDB.setFloat(&fbdo, fbPath("/ThongSo/AnhSang"), anhSang)) {
          ok = false;
          Serial.print("Loi AnhSang: ");
          Serial.println(fbdo.errorReason());
        }
      } else {
        ok = false;
        Serial.println("Bo qua AnhSang: gia tri khong hop le");
      }

      float apSuat = bmp.readPressure() / 100.0F;
      float doCao = bmp.readAltitude(1013.25);

      if (isfinite(apSuat) && apSuat > 0) {
        Firebase.RTDB.setFloat(&fbdo, fbPath("/ThongSo/ApSuat"), apSuat);
      }

      if (isfinite(doCao)) {
        Firebase.RTDB.setFloat(&fbdo, fbPath("/ThongSo/DoCao"), doCao);
      }

      // Dashboard tính độ trễ cảm biến từ Date.now() - espSentAt.
      Firebase.RTDB.setString(&fbdo, fbPath("/ThongSo/espSentAt"), epochMsToString(espSentAt));
      Firebase.RTDB.setInt(&fbdo, fbPath("/ThongSo/seq"), (int)sensor_seq);
      Firebase.RTDB.setString(&fbdo, fbPath("/ThongSo/robotId"), ROBOT_ID);

      Firebase.RTDB.setString(&fbdo, fbPath("/ThietBi/TrangThai"), "ONLINE");
      Firebase.RTDB.setString(&fbdo, fbPath("/ThietBi/IP"), WiFi.localIP().toString());
      Firebase.RTDB.setString(&fbdo, fbPath("/ThietBi/ManHinh"), String(trang_thai_man_hinh));
      Firebase.RTDB.setString(&fbdo, fbPath("/ThietBi/ThoiGianCapNhat"), nowEpochMsString());

      Firebase.RTDB.setString(&fbdo, fbPath("/RobotInfo/status"), "ONLINE");
      Firebase.RTDB.setString(&fbdo, fbPath("/RobotInfo/ip"), WiFi.localIP().toString());
      Firebase.RTDB.setInt(&fbdo, fbPath("/RobotInfo/lastSeen"), (int)time(nullptr));

      if (ok) {
        Serial.println("--> Da day du lieu moi truong len Firebase!");
      }
    } else {
      Serial.println("Firebase chua ready, dang cho token...");
    }
  }
}
